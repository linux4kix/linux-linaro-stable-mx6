/*
 * Copyright 2014 John Weber
 * Copyright 2013 Boundary Devices
 * Copyright 2012 Freescale Semiconductor, Inc.
 * Copyright 2011 Linaro Ltd.
 *
 * The code contained herein is licensed under the GNU General Public
 * License. You may obtain a copy of the GNU General Public License
 * Version 2 or later at the following locations:
 *
 * http://www.opensource.org/licenses/gpl-license.html
 * http://www.gnu.org/copyleft/gpl.html
 */

/dts-v1/;

#include <dt-bindings/interrupt-controller/irq.h>
#include "imx6q-common-wandboard.dtsi"
#include "imx6qdl-wandboard.dtsi"

/ {
	model = "Wandboard Quad based on Freescale i.MX6 Quad";
	compatible = "fsl,imx6q-wandboard", "fsl,imx6q";
};

&mxcfb1 {
	status = "okay";
};

#if 0
&mxcfb2 {
	status = "okay";
};

&mxcfb3 {
	status = "okay";
};

&mxcfb4 {
	status = "okay";
};
#endif

&sata {
	status = "okay";
};

