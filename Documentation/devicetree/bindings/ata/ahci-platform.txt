## Documentation/devicetree/bindings/ata/ahci-platform.txt
```
* AHCI SATA Controller

SATA nodes are defined to describe on-chip Serial ATA controllers.
Each SATA controller should have its own node.

Required properties:
- compatible        : compatible list, contains "snps,spear-ahci",
		      "fsl,imx53-ahci" or "fsl,imx6q-ahci"
- interrupts        : <interrupt mapping for SATA IRQ>
- reg               : <registers mapping>

Optional properties:
- dma-coherent      : Present if dma operations are coherent
- clocks            : a list of phandle + clock specifier pairs
- target-supply     : regulator for SATA target power

"fsl,imx53-ahci", "fsl,imx6q-ahci" required properties:
- clocks            : must contain the sata, sata_ref and ahb clocks
- clock-names       : must contain "ahb" for the ahb clock

Example:
        sata@ffe08000 {
		compatible = "snps,spear-ahci";
		reg = <0xffe08000 0x1000>;
		interrupts = <115>;

        };
```

## drivers/gpu/drm/galcore/Kconfig
```kconfig
config DRM_GALCORE
	tristate "DRM support for Vivante GPUs using galcore"
	depends on DRM && ARM
	help
	  Provide an Memory Management interface into the GEM MM subsystem
	  for Vivante GPU's still using the out of tree Galcore driver.

	  This driver provides no hardware support; it is simple here for 
	  Memory Allocation and as an interface for dmabuf.
```

## drivers/mxc/gpu-viv/Kconfig
```kconfig
menu "MXC Vivante GPU support"
	depends on SOC_IMX6Q

config MXC_GPU_VIV
	tristate "MXC Vivante GPU support"
	---help---
         Say Y to get the GPU driver support.
choice
	prompt "Galcore Version"
	default MXC_GPU_VIV_V5

config MXC_GPU_VIV_V5
	bool "Galcore Version 5.x"

config MXC_GPU_VIV_V4
	bool "Galcore Version 4.x"

endchoice

endmenu
```

## drivers/staging/vivante/Kconfig
```kconfig
config DRM_VIVANTE
	tristate "Vivante DRM"
	depends on DRM
	select SHMEM
	select TMPFS
	select IOMMU_API
	default y
	help
	  DRM driver for Vivante GPUs.

config DRM_VIVANTE_REGISTER_LOGGING
	bool "Vivante DRM register logging"
	depends on DRM_VIVANTE
	default n
	help
	  Compile in support for logging register reads/writes in a format
	  that can be parsed by envytools demsm tool.  If enabled, register
	  logging can be switched on via vivante.reglog=y module param.
```
